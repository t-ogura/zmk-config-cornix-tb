## config/boards/shields/trackball_paw3222/Kconfig.shield
```kconfig
config SHIELD_TRACKBALL_PAW3222
    def_bool $(shields_list_contains,trackball_paw3222)
```

## west.yml
```yaml
manifest:
  remotes:
    - name: zmkfirmware
      url-base: https://github.com/zmkfirmware
    - name: hitsmaxft
      url-base: https://github.com/hitsmaxft
    - name: sekigon-gonnoc
      url-base: https://github.com/sekigon-gonnoc
    - name: urob
      url-base: https://github.com/urob
    - name: caksoylar
      url-base: https://github.com/caksoylar
    - name: prospector
      url-base: https://github.com/t-ogura
  projects:
    - name: zmk
      remote: zmkfirmware
      revision: main
      import: app/west.yml
    - name: zmk-keyboard-cornix
      remote: hitsmaxft
      revision: main
    - name: zmk-driver-paw3222
      remote: sekigon-gonnoc
      revision: main
    - name: zmk-helpers
      remote: urob
      revision: main
    - name: zmk-rgbled-widget
      remote: hitsmaxft
      revision: main
    - name: prospector-zmk-module
      remote: prospector
      revision: feature/v2.0-multi-peripheral-investigation
      path: modules/prospector-zmk-module
  self:
    path: .
```

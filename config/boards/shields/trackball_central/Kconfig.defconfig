## config/boards/shields/trackball_central/Kconfig.defconfig
```kconfig
if SHIELD_TRACKBALL_CENTRAL

config ZMK_KEYBOARD_NAME
    default "Cornix TB"

endif # SHIELD_TRACKBALL_CENTRAL
```

## config/boards/shields/trackball_central/Kconfig.shield
```kconfig
config SHIELD_TRACKBALL_CENTRAL
    def_bool $(shields_list_contains,trackball_central)
```

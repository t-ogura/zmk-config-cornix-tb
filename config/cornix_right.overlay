// Right as peripheral (xiao-as-central branch):
// - No central-side trackball input wiring (the Xiao central owns the
//   local PAW3222 listener)
// - No USB CDC ACM console (USB stack disabled on peripheral)
//
// Same inert-stub pattern as cornix_left.overlay: the shared keymap
// references `&trackball_listener { input-processors = ... }`, so the
// node label must exist. With status "disabled" and ZMK_INPUT_SPLIT=n,
// no driver matches and the override is ignored at runtime.
#include <dt-bindings/zmk/input_transform.h>

/{
    split_inputs {
        #address-cells = <1>;
        #size-cells = <0>;

        trackball_split: trackball_split@0 {
            compatible = "zmk,input-split";
            reg = <0>;
            status = "disabled";
        };
    };

    trackball_listener: trackball_listener {
        compatible = "zmk,input-listener";
        device = <&trackball_split>;
        status = "disabled";
    };
};
